## conf/layer.conf
```bitbake
# We have a conf and classes directory, add to BBPATH
BBPATH .= ":${LAYERDIR}"

# We have recipes-* directories, add to BBFILES
BBFILES += "${LAYERDIR}/recipes-*/*/*.bb \
            ${LAYERDIR}/recipes-*/*/*.bbappend \
"

BBFILE_COLLECTIONS += "meta-perl-ssti"
BBFILE_PATTERN_meta-perl-ssti = "^${LAYERDIR}/"
BBFILE_PRIORITY_meta-perl-ssti = "6"

LAYERSERIES_COMPAT_meta-gunshot = "warrior zeus dunfell gatesgarth"
```
